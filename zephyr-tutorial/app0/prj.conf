## CMakeLists.txt
```
# Minimum CMake version required
cmake_minimum_required(VERSION 3.20.0)

# Include Zephyr
find_package(Zephyr REQUIRED HINTS $ENV{ZEPHYR_BASE})

# Define project
project(
  app0
  VERSION 1.0
  DESCRIPTION "Zephyr project generated by script"
  LANGUAGES C
)

# Add main source file
target_sources(app PRIVATE src/main.c)

# Optional: Add include directories
# target_include_directories(app PRIVATE include)

# Optional: Add additional sources
# target_sources(app PRIVATE src/utils.c src/device.c)

# Optional: Add libraries
# target_link_libraries(app PRIVATE my_custom_lib)

# Optional: Define compile definitions
# target_compile_definitions(app PRIVATE MY_MACRO=1)

# Optional: Compiler options
# target_compile_options(app PRIVATE -Wall -Werror)
```

## prj.conf
```kconfig
# Project configuration goes here
```

## boards/app.overlay
```dts
// Device tree overlay: app.overlay
```

## src/main.c
```c
#include <zephyr/kernel.h>

// #include <zephyr/drivers/gpio.h>
// #include "my_header.h"

void main(void) {
    // Initialization here
    // Example:
    // printk("Hello, Zephyr!\n");

    // while (1) {
    //     k_sleep(K_SECONDS(1));
    // }
}
```
