## zephyr-feasibility-emul/modules/rohm_bt1750_emul/drivers/rohm_bt1750_emul/Kconfig
```kconfig
config ROHM_BT1750_EMUL
        bool "Emulate rohm_bt1750_emul with i2c interface"
  default n
        depends on EMUL
        help
          This is an emulator for the Sensirion SHT3XD temperature and humidity sensor.
```

## zephyr-feasibility-emul/modules/rohm_bt1750_emul/dts/bindings/sensor/rohm,bt1750-emul.yaml
```yaml
description: Emulator for rohm_bt1750_emul

compatible: "rohm,bt1750-emul.yaml"

include: [sensor-device.yaml, i2c-device.yaml]
```

## zephyr-feasibility-emul/modules/sensirion_sht3xd_emul/dts/bindings/emul/emul,sensirion,sht3xd.yaml
```yaml
compatible: "emul,sensirion,sht3xd"

properties:
  reg:
    description: Emulator I2C address
    type: int
    required: true

description: Emulator for Sensirion SHT3XD sensor
```

## zephyr-feasibility-emul/modules/sensirion_sht3xd_emul/dts/bindings/sensor/sensirion,sht3xd-emul.yaml
```yaml
description: Emulator for Sensirion SHT3XD sensor

compatible: "sensirion,sht3xd-emul"

include: [sensor-device.yaml, i2c-device.yaml]
```

## zephyr-feasibility/modules/mock_sensor/drivers/mock_sensor/Kconfig
```kconfig
# Create a new option in menuconfig
config MOCK_SENSOR
    bool "Mock Sensor"
    default n       # Set the driver to be disabled by default
    depends on GPIO # Make it dependent on GPIO driver
    help
        Enable the custom button driver.
```

## zephyr-feasibility/modules/mock_sensor/dts/bindings/input/mock,sensor.yaml
```yaml
# SPDX-License-Identifier: Apache-2.0

description: Mock Sensor Device

compatible: "mock,sensor"

properties:
  label:
    required: true
    type: string
    description: Human-readable string describing the sensor instance

  reg:
    type: int
    required: false
    description: Optional I2C/SPI/UART address or chip select

  pin:
    type: int
    required: false
    description: Optional GPIO pin number, used only if needed

  spi-max-frequency:
    type: int
    required: false
    description: Maximum SPI clock frequency in Hz
```

## zephyr-feasibility/modules/rohm_bh1750_emul/drivers/rohm_bh1750_emul/Kconfig
```kconfig
config ROHM_BH1750_EMUL
        bool "Emulate rohm_bh1750_emul with i2c interface"
  default n
        depends on EMUL
        help
          This is an emulator for the BH1750 light sensor.
```

## zephyr-feasibility/modules/rohm_bh1750_emul/dts/bindings/sensor/rohm,bt1750-emul.yaml
```yaml
description: Emulator for rohm_bh1750_emul

compatible: "rohm,bh1750-emul.yaml"

include: [sensor-device.yaml, i2c-device.yaml]
```

## zephyr-feasibility/modules/sensirion_sht3xd_emul/drivers/sensirion_sht3xd_emul/Kconfig
```kconfig
config SENSIRION_SHT3XD_EMUL
	bool "Emulate Sensirion SHT3XD I2C chip"
  default n
	depends on EMUL
	help
	  This is an emulator for the Sensirion SHT3XD temperature and humidity sensor.
```

## zephyr-feasibility/modules/sx1262_emul/drivers/sx1262_emul/Kconfig
```kconfig
config SX1262_EMUL
        bool "Emulate sx1262_emul with spi interface"
  default n
        depends on EMUL
        help
          This is an emulator for the sx1262_emul sensor.
```

## zephyr-feasibility/modules/sx1262_emul/dts/bindings/rf/semtech,sx1262-emul.yaml
```yaml
# Copyright (c) 2024, Enea Scaccabarozzi
# SPDX-License-Identifier: Apache-2.0

description: |
  Semtech SX1262 LoRa Transceiver Emulator.
  This binding is self-contained and explicitly defines all required
  SPI properties to avoid issues with the 'include' directive.

compatible: "semtech,sx1262-emul"

on-bus: spi

properties:
  # Proprietà SPI Standard
  reg:
    type: int
    required: true
    description: The chip select address of the SPI device.
  spi-max-frequency:
    type: int
    required: false
    description: Maximum SPI clock frequency for the device in Hz.
  duplex:
    type: int
    required: false
    description: |
      The SPI duplex mode.
      0 for half-duplex, 1 for full-duplex.
  frame-format:
    type: int
    required: false
    description: The SPI frame format.
  cs-active-high:
    type: boolean
    description: CS line is active high.
  spi-cpha:
    type: boolean
    description: Clock phase.
  spi-cpol:
    type: boolean
    description: Clock polarity.

  # Proprietà specifiche del nostro emulatore
  reset-gpios:
    type: phandle-array
    required: true
    description: Reset pin
  busy-gpios:
    type: phandle-array
    required: true
    description: Busy pin
  dio1-gpios:
    type: phandle-array
    required: true
    description: DIO1 pin (interrupt)
```

## zephyr-feasibility/modules/sx1262_emul/dts/bindings/rf/sx1262,emul.yaml
```yaml
description: Emulator for sx1262_emul

compatible: "sx1262,emul.yaml"

include: [sensor-device.yaml, spi-device.yaml]
```

## zephyr-feasibility/src/Kconfig
```kconfig
menu "Mock Sensor Configuration"

config MOCK_SENSOR
    bool "Enable Mock Sensor"
    default y
    help
      Enable support for the mock sensor driver.

endmenu
```
